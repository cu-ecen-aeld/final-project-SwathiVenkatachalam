## base_external/package/aesd-project/Config.in
```kconfig
config BR2_PACKAGE_AESD_PROJECT
	bool "aesd-project"
	help
	  Includes the camera driver code and socket.
	  Used to understand buildroot external trees and package builds.
```

## base_external/package/sv-app/Config.in
```kconfig
config BR2_PACKAGE_SV_APP
	bool "sv-app"
	help
	  Includes the stereo vision code.
```
